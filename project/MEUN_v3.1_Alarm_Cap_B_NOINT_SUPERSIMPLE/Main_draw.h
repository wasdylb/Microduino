#include "Arduino.h"

#define u8g_logo_width 32
#define u8g_logo_height 32

const unsigned char u8g_logo_bits[] U8G_PROGMEM = {
  0x00, 0x00, 0x00, 0x00, 0x00, 0xFF, 0xFF, 0x00, 0xE0, 0xFF, 0xFF, 0x07, 0xF0, 0xFF, 0xFF, 0x0F,
  0xF8, 0xFF, 0xFF, 0x1F, 0xFC, 0xFF, 0xFF, 0x3F, 0xFC, 0xFF, 0xFF, 0x3F, 0xFC, 0xFF, 0xFF, 0x7F,
  0xFE, 0xC3, 0xC3, 0x7F, 0xFE, 0xC3, 0xC3, 0x7F, 0xFE, 0xC3, 0xC3, 0x7F, 0xFE, 0xC3, 0xC3, 0x7F,
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  0xF0, 0xFF, 0xFF, 0x0F, 0xE0, 0xFF, 0xFF, 0x07, 0x00, 0xFF, 0xFF, 0x00, 0x00, 0x00, 0x00, 0x00
};

//主界面，可自由定义
void drawMain()
{
  u8g.drawXBMP( 2, 6, u8g_logo_width, u8g_logo_height, u8g_logo_bits);

  setFont_M;
  u8g.setFontRefHeightText();
  u8g.setPrintPos(52, 16);
  u8g.print(Year);
  u8g.print('-');
  if (Month < 10)
    u8g.print("0");
  u8g.print(Month);
  u8g.print('-');
  if (Day < 10)
    u8g.print("0");
  u8g.print(Day);

  setFont_L;
  //u8g.setFont(u8g_font_9x15Br);
  //u8g.setFont(u8g_font_9x18Br);
  //u8g.setFont(u8g_font_courB24n);
  u8g.setFontRefHeightText();
  u8g.setPrintPos(61, 36);
  if (Hour < 10)
    u8g.print("0");
  u8g.print(Hour);
  u8g.setPrintPos(81, 36);
  u8g.print(Second % 2 ? ":" : " ");
  u8g.setPrintPos(91, 36);
  if (Minute < 10)
    u8g.print("0");
  u8g.print(Minute);

  u8g.setFontRefHeightText();
  u8g.setPrintPos(61, 60);
  if (alarm_hour < 10)
    u8g.print("0");
  u8g.print(alarm_hour);
  u8g.setPrintPos(81, 60);
  u8g.print(":");
  u8g.setPrintPos(91, 60);
  if (alarm_minute < 10)
    u8g.print("0");
  u8g.print(alarm_minute);

  if (alarm_switch)
  {
    u8g.setPrintPos(6, 60);
    u8g.print("ON");
  }
  else
  {
    u8g.setPrintPos(2, 60);
    u8g.print("OFF");
  }
}

